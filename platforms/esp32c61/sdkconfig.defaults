## platforms/esp32c61/sdkconfig.defaults
```kconfig
CONFIG_ESP_TASK_WDT_EN=n
CONFIG_BOOTLOADER_WDT_ENABLE=n
CONFIG_ESP_SYSTEM_PANIC_PRINT_REBOOT=y
CONFIG_ESP_SYSTEM_PANIC_REBOOT_DELAY_SECONDS=5
CONFIG_ESP_MAIN_TASK_STACK_SIZE=32768
```
